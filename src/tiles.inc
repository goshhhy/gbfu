IMG_GB_POCKET equ $00 

IMG_FLASH_CART equ $04 

IMG_GAME_CART equ $08 

IMG_PROG_0 equ $0C 
IMG_PROG_1 equ $0D 
IMG_PROG_2 equ $0E 
IMG_PROG_3 equ $0F 

IMG_ARROW_HEAD_0 equ $10 
IMG_ARROW_HEAD_1 equ $11 
IMG_ARROW_HEAD_2 equ $12 
IMG_ARROW_HEAD_3 equ $13 

IMG_ARROW_TAIL_0 equ $14 
IMG_ARROW_TAIL_1 equ $15 
IMG_ARROW_TAIL_2 equ $16 
IMG_ARROW_TAIL_3 equ $17 

IMG_CLOCK        equ $18 

IMG_X_CHECK_0   equ $1c 
IMG_CHECK_1     equ $1d 
IMG_X_CHECK_2   equ $1e 
IMG_CHECK_3     equ $1f 
 
IMG_PC          equ $20

IMG_CABLE       equ $24

IMG_ERASE       equ $28
IMG_WRITE       equ $29
IMG_CHECK       equ $2a

IMG_BLANK       equ $2b

IMG_BUN         equ $2c

IMG_TEXT_START  equ $30